## meta-phy/conf/layer.conf
```bitbake
# We have a conf and classes directory, add to BBPATH
BBPATH .= ":${LAYERDIR}"

# We have recipes-* directories, add to BBFILES
BBFILES += "${LAYERDIR}/recipes-*/*/*.bb \
            ${LAYERDIR}/recipes-*/*/*.bbappend"

BBFILE_COLLECTIONS += "meta-phy"
BBFILE_PATTERN_meta-phy = "^${LAYERDIR}/"
BBFILE_PRIORITY_meta-phy = "7"

LAYERDEPENDS_meta-phy = "core"
LAYERSERIES_COMPAT_meta-phy = "kirkstone"
```
